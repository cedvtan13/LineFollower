/*
 * Driver for SH1106 1.3" OLED (128x64) over I2C.
 * SH1106 has a 132-column internal buffer; visible columns start at offset 2.
 * Page-addressing only.
 */

#include "sh1106.h"
#include <stdint.h>
#include <string.h>

extern I2C_HandleTypeDef hi2c1;

#define SH1106_ADDR    0x78
#define SH1106_COL_OFS 2

static void sh1106_WriteCommand(uint8_t cmd)
{
    uint8_t buf[2] = {0x00, cmd};
    if (HAL_I2C_Master_Transmit(&hi2c1, SH1106_ADDR, buf, 2, 100) != HAL_OK) {
        Error_Handler();
    }
}

static void sh1106_WriteData(uint8_t data)
{
    uint8_t buf[2] = {0x40, data};
    HAL_I2C_Master_Transmit(&hi2c1, SH1106_ADDR, buf, 2, 100);
}

static const uint8_t font5x7[][5] = {
    {0x00,0x00,0x00,0x00,0x00},{0x00,0x00,0x5F,0x00,0x00},{0x00,0x07,0x00,0x07,0x00},{0x14,0x7F,0x14,0x7F,0x14},
    {0x24,0x2A,0x7F,0x2A,0x12},{0x23,0x13,0x08,0x64,0x62},{0x36,0x49,0x55,0x22,0x50},{0x00,0x05,0x03,0x00,0x00},
    {0x00,0x1C,0x22,0x41,0x00},{0x00,0x41,0x22,0x1C,0x00},{0x14,0x08,0x3E,0x08,0x14},{0x08,0x08,0x3E,0x08,0x08},
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    {0x00,0x00,0x7F,0x00,0x00},{0x00,0x41,0x36,0x08,0x00},{0x08,0x08,0x2A,0x1C,0x08},{0x08,0x1C,0x2A,0x08,0x08}
};

static uint8_t sh1106_buf[8][128];
static uint8_t curPage = 0;
static uint8_t curCol = 0;

void sh1106_SendCommand(uint8_t cmd) { sh1106_WriteCommand(cmd); }
void sh1106_SendData(uint8_t data) { sh1106_WriteData(data); }

void sh1106_Init(void)
{
    HAL_Delay(200);
    sh1106_WriteCommand(0xAE);
    sh1106_WriteCommand(0x02);
    sh1106_WriteCommand(0x10);
    sh1106_WriteCommand(0x40);
    sh1106_WriteCommand(0x81);
    sh1106_WriteCommand(0x7F);
    sh1106_WriteCommand(0xA1);
    sh1106_WriteCommand(0xC8);
    sh1106_WriteCommand(0xA6);
    sh1106_WriteCommand(0xA8);
    sh1106_WriteCommand(0x3F);
    sh1106_WriteCommand(0xD3);
    sh1106_WriteCommand(0x00);
    sh1106_WriteCommand(0xD5);
    sh1106_WriteCommand(0x80);
    sh1106_WriteCommand(0xD9);
    sh1106_WriteCommand(0xF1);
    sh1106_WriteCommand(0xDA);
    sh1106_WriteCommand(0x12);
    sh1106_WriteCommand(0xDB);
    sh1106_WriteCommand(0x40);
    sh1106_WriteCommand(0xAD);
    sh1106_WriteCommand(0x8B);
    sh1106_WriteCommand(0x30);
    sh1106_WriteCommand(0xA4);
    sh1106_Clear();
    sh1106_Display();
    sh1106_WriteCommand(0xAF);
}

void sh1106_SetCursor(uint8_t x, uint8_t y)
{
    curCol = (x < 128) ? x : 127;
    curPage = (y < 8) ? y : 7;
}

static void sh1106_WriteChar(char ch)
{
    uint8_t idx;
    int i;

    if (ch < 32 || ch > 127) ch = 32;
    idx = (uint8_t)(ch - 32);
    for (i = 0; i < 5; i++) {
        if (curCol < 128) sh1106_buf[curPage][curCol++] = font5x7[idx][i];
    }
    if (curCol < 128) sh1106_buf[curPage][curCol++] = 0x00;
}

void sh1106_WriteString(const char *str)
{
    while (*str) sh1106_WriteChar(*str++);
}

void sh1106_Clear(void)
{
    memset(sh1106_buf, 0, sizeof(sh1106_buf));
    curCol = 0;
    curPage = 0;
}

void sh1106_Display(void)
{
    static uint8_t lineBuf[129];
    uint8_t page;

    lineBuf[0] = 0x40;
    for (page = 0; page < 8; page++) {
        sh1106_WriteCommand((uint8_t)(0xB0 | page));
        sh1106_WriteCommand((uint8_t)(0x10 | (SH1106_COL_OFS >> 4)));
        sh1106_WriteCommand((uint8_t)(0x00 | (SH1106_COL_OFS & 0x0F)));
        memcpy(lineBuf + 1, sh1106_buf[page], 128);
        HAL_I2C_Master_Transmit(&hi2c1, SH1106_ADDR, lineBuf, 129, 100);
    }
}

void sh1106_DrawPixel(uint8_t x, uint8_t y, uint8_t on)
{
    if (x >= 128 || y >= 64) return;
    if (on) sh1106_buf[y >> 3][x] |= (uint8_t)(1u << (y & 7));
    else sh1106_buf[y >> 3][x] &= (uint8_t)~(1u << (y & 7));
}

static void DrawHLine(uint8_t x, uint8_t y, uint8_t w)
{
    uint8_t i;
    for (i = 0; i < w; i++) sh1106_DrawPixel((uint8_t)(x + i), y, 1);
}

static void DrawVLine(uint8_t x, uint8_t y, uint8_t h)
{
    uint8_t i;
    for (i = 0; i < h; i++) sh1106_DrawPixel(x, (uint8_t)(y + i), 1);
}

void sh1106_DrawRect(uint8_t x0, uint8_t y0, uint8_t x1, uint8_t y1)
{
    DrawHLine(x0, y0, (uint8_t)(x1 - x0 + 1));
    DrawHLine(x0, y1, (uint8_t)(x1 - x0 + 1));
    DrawVLine(x0, y0, (uint8_t)(y1 - y0 + 1));
    DrawVLine(x1, y0, (uint8_t)(y1 - y0 + 1));
}

void sh1106_FillRect(uint8_t x0, uint8_t y0, uint8_t x1, uint8_t y1)
{
    uint8_t x;
    uint8_t y;
    for (y = y0; y <= y1; y++) {
        for (x = x0; x <= x1; x++) {
            sh1106_DrawPixel(x, y, 1);
        }
    }
}